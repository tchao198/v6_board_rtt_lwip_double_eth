## bsp/stm32f429-armfly/Kconfig
```kconfig
mainmenu "RT-Thread Configuration"

config $BSP_DIR
    string
    option env="BSP_ROOT"
    default "D:\stm32\rt-thread-3.0.3\bsp\stm32f429-armfly"

config $RTT_DIR
    string
    option env="RTT_ROOT"
    default "D:\stm32\rt-thread-3.0.3"

config $PKGS_DIR
    string
    option env="PKGS_ROOT"
    default "packages"

config BOARD_STM32F429_ARMFLY
    bool 
    select ARCH_ARM_CORTEX_M4
    default y

source "$RTT_DIR/Kconfig"
source "$PKGS_DIR/Kconfig"

source "$BSP_DIR/drivers/Kconfig"
```
